## Kconfig
```kconfig
config ZMK_MEJIRO
    bool "Enable Mejiro behavior module"
    default y
    depends on !ZMK_SPLIT || ZMK_SPLIT_ROLE_CENTRAL
```

## dts/bindings/behaviors/zmk,behavior-mejiro.yaml
```yaml
description: Mejiro behavior
compatible: "zmk,behavior-mejiro"
include: one_param.yaml
properties:
  label:
    type: string
    required: false
    deprecated: true
```

## dts/bindings/behaviors/zmk,behavior-naginata.yaml
```yaml
description: Naginata behavior
compatible: "zmk,behavior-naginata"
include: one_param.yaml
properties:
  label:
    type: string
    required: false
    deprecated: true
```
